## linux/drivers/Kconfig
```kconfig
menu "LiME drivers"

config LMCACHE
	tristate "LiME cache management"
	depends on ARCH_ZYNQMP
	help
	  Provides cache flush and invalidate operations.

config LMALLOC
	tristate "LiME memory allocation and translation"
	depends on ARCH_ZYNQMP
	help
	  Provides contiguous memory allocation and address translation.

endmenu
```

## linux/fit_image.its
```
/dts-v1/;

/ {
    description = "U-Boot fitImage for MPSoC Linux Kernel";
    #address-cells = <1>;

    images {
        kernel@0 {
            description = "Linux Kernel";
            data = /incbin/("linux-xlnx/arch/arm64/boot/Image");
            type = "kernel";
            arch = "arm64";
            os = "linux";
            compression = "none";
            load =  <0x00 0x00080000>;
            entry = <0x10 0x00080000>;
            hash@1 {
                algo = "sha1";
            };
        };
        fdt@0 {
            description = "Flattened Device Tree blob";
            data = /incbin/("dts/system.dtb");
            type = "flat_dt";
            arch = "arm64";
            compression = "none";
            hash@1 {
                algo = "sha1";
            };
        };
    };
    configurations {
        default = "conf@1";
        conf@1 {
            description = "Boot Linux kernel with FDT blob";
            kernel = "kernel@0";
            fdt = "fdt@0";
            hash@1 {
                algo = "sha1";
            };
        };
    };
};
```
